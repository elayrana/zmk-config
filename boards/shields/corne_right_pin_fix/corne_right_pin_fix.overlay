// Remap row 3 from pro_micro 7 (P1.00, damaged) to pro_micro 9 (P1.04).
// Requires bridge wire on right Corne PCB: P1.00 pad → P1.04 pad.
&kscan0 {
    row-gpios
        = <&pro_micro 4 (GPIO_ACTIVE_HIGH | GPIO_PULL_DOWN)>
        , <&pro_micro 5 (GPIO_ACTIVE_HIGH | GPIO_PULL_DOWN)>
        , <&pro_micro 6 (GPIO_ACTIVE_HIGH | GPIO_PULL_DOWN)>
        , <&pro_micro 9 (GPIO_ACTIVE_HIGH | GPIO_PULL_DOWN)>
        ;
};
